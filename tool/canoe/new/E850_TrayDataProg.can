/*@@var:*/
variables
{
    Message 0x7ef command;
    int a=0;
    int count=0;
    byte Seed_value0;
    byte Seed_value1;
    word Seed_value;
    word Key_value;
    word Header_seed;
  
//    byte Data_R3;
//    byte Data_R4;
  
//    Word Realy_On;
//    Word Relay_Off;
//    Word Acc1;
//    Word Acc2;
//    Word Acc3;    
}
/*@@end*/

/*@@startStart:Start:*/
on start
{
  int i = 0;
  for(i=0;i<8; i++)
  {
    command.byte(i)=0xFF;
  }
}
/*@@end*/

/*@@key:'c':*/
on key 'c'
{
  a=a+1;
  if(count == 0)
  {   
  switch (a)
  {
   case 1:
     command.byte(0) = 0x10;
     command.byte(1) = 0x02;
     command.byte(2) = 0x00;
     command.byte(3) = 0x00;
     write("Diag mode access");
     output(command);
      break;
   case 2:
     command.byte(0) = 0x27;
     command.byte(1) = 0x01;
     command.byte(2) = 0x00;
     command.byte(3) = 0x00;
     write("Request for SEED value");
     output(command);
     count = 1;
       break;
    case 3:
     command.byte(0) = 0x27;
     command.byte(1) = 0x02;
     command.byte(2) = 0x5d;
     command.byte(3) = 0x55;
     write("Return KEY value");
     output(command);
     a=0;
       break;
    
    default:
     command.byte(0) = 0xFF;
     command.byte(1) = 0xFF;
     command.byte(2) = 0xFF;
     command.byte(3) = 0xFF;
     write("Error Occured ");
     break;
  }
  }
  else
  {
   switch (a)
  {
   case 1:
     command.byte(0) = 0x10;
     command.byte(1) = 0x02;
     command.byte(2) = 0x00;
     command.byte(3) = 0x00;
     write("Diag mode access");
     output(command);
      break;
   case 2:
     command.byte(0) = 0x27;
     command.byte(1) = 0x01;
     command.byte(2) = 0x00;
     command.byte(3) = 0x00;
     write("Request for SEED value");
     output(command);
       break;
    case 3:
     command.byte(0) = 0x27;
     command.byte(1) = 0x02;
     command.word(2) = Key_value;
//     command.byte(3) = 0x55;
     write("Return KEY value");
     output(command);
     a=0;
       break;
    
    default:
     command.byte(0) = 0xFF;
     command.byte(1) = 0xFF;
     command.byte(2) = 0xFF;
     command.byte(3) = 0xFF;
     write("Error Occured ");
     break;
  } 
  }
}
/*@@end*/

/*@@msg:0x7F0:*/
on message 0x7f0
{
  Header_seed = this.word(0);
  if( Header_seed == 0x0167)
  {
  Seed_value = this.word(2);
  Seed_value = swapWord(Seed_value);
  Key_value = (0x9164 * Seed_value + 0x1665)%0x10000;
  Key_value = swapWord(Key_value);
  }
  else
  {
    ;
  }
}
/*@@end*/

/*@@key:'f':*/
on key 'f'
{
     command.byte(0) = 0x30;
     command.byte(1) = 0x02;
     command.byte(2) = 0xFF;
     command.byte(3) = 0xFF;
     write("Relay OFF");
     output(command);
     }
/*@@end*/

/*@@key:'o':*/
on key 'o'
{
     command.byte(0) = 0x30;
     command.byte(1) = 0x01;
     command.byte(2) = 0xFF;
     command.byte(3) = 0xFF;
     write("Relay ON");
     output(command);
}
/*@@end*/

/*@@key:'v':*/
on key 'v'
{
     command.byte(0) = 0x42;
     command.byte(1) = 0xe0;
     command.byte(2) = 0xFF;
     command.byte(3) = 0xFF;
     write("rbms cell vol");
     output(command);
}
/*@@end*/

