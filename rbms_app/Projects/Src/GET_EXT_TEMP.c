/*
 * <모듈 요약>
 * <모듈 상세 설명>
 */

#include "GET_EXT_TEMP.h"

/*== MACRO ===================================================================*/

#define TEMP_TBL_CNT 191
#define TEMP_IDX 0
#define TEMP_AD_IDX 1
/*== GLOBAL VARIABLE =========================================================*/

_EXT_TEMP FET_TEMP;
_EXT_TEMP BD_TEMP;

/*== STATIC VARIABLE =========================================================*/

static const float TEMP_TABLE[2][TEMP_TBL_CNT] =
{
    /* 온도 */
    {
        -40, -39, -38, -37, -36, -35, -34, -33, -32, -31, -30, -29, -28, -27, -26, -25, -24, -23, -22, -21,
        -20, -19, -18, -17, -16, -15, -14, -13, -12, -11, -10,  -9,  -8,  -7,  -6,  -5,  -4,  -3,  -2,  -1,
        0,   1,   2,   3,   4,   5,   6,   7,   8,   9, 10,  11,  12,  13,  14,  15,  16,  17,  18,  19,
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        140, 141, 142, 143, 144, 145, 146, 147, 148, 149, 150
    },
    /* 전압 (V) */
    {
        3.135024786, 3.126315832, 3.117225170, 3.107748270, 3.097868443, 3.087590218, 3.076876163, 3.065741539, 3.054153204, 3.042127132,
        3.029641151, 3.016665220, 3.003237486, 2.989297628, 2.974870443, 2.959937334, 2.944492340, 2.928533077, 2.912047625, 2.895037413,
        2.877486467, 2.859406710, 2.840780020, 2.821621180, 2.801909208, 2.781661749, 2.760872364, 2.739537954, 2.717671156, 2.695272207,
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        0.121219613, 0.118749708, 0.116340466, 0.113986023, 0.111686617, 0.109442502, 0.107253917, 0.105114922, 0.103025697, 0.100983366,
        0.098991193
    }
};

/*== FUNCTION DECLARATION ====================================================*/

/**
 * @param[in] adv voltage from adc of temperature
 * @return temperature in celius. (-40 ~ 150)
 */
static int16_t __calculate(float adv);

/*== FUNCTION DEFINITION =====================================================*/

int16_t __calculate(float adv)
{
    float temperature;
    float diff, diff2;

    uint16_t i;
    temperature = TEMP_TABLE[TEMP_IDX][0];  // Minimum
    // Compare Measure Real Temp V to R-T Table
    for (i = 0; i < TEMP_TBL_CNT; i++)
    {
        if (TEMP_TABLE[TEMP_AD_IDX][i] < adv)
        {
            break;
        }
        temperature += 1.0f; // 1도씩 올라감.
    }

    if (i == 0)
    {
        return (int16_t)TEMP_TABLE[TEMP_IDX][0] * 100;
    }
    else if (i >= TEMP_TBL_CNT)
    {
        return (int16_t)TEMP_TABLE[TEMP_IDX][TEMP_TBL_CNT - 1] * 100;
    }

    // 소수점 첫째자리까지 계산 한다.
    // Current Temp Table 1Step Down
    // Current Temp - 1 Step Down Temp
    diff = TEMP_TABLE[TEMP_AD_IDX][i-1] - TEMP_TABLE[TEMP_AD_IDX][i];
    diff2 = TEMP_TABLE[TEMP_AD_IDX][i-1] - adv;
    diff = diff2 / diff;
    temperature += diff- 1;

    // scale factor is 10e-2 i.e. (1/100)
    return (int16_t)(temperature * 100);
}

void GET_EXT_TEMPERATURE(void)
{
    FET_TEMP.AVG_TEMP_BUF += EXT_TEMP_ADC_CH10;
    FET_TEMP.AVG_CHK_CNT++;

    if (TEMP_AVG_CNT == FET_TEMP.AVG_CHK_CNT)
    {
        float avgFetTemp;
        FET_TEMP.AVG_CHK_CNT = 0;
        FET_TEMP.AVG_TEMP_BUF = (FET_TEMP.AVG_TEMP_BUF / TEMP_AVG_CNT);

        // To need change real current..
        avgFetTemp = 3.3 * FET_TEMP.AVG_TEMP_BUF / 4096;    // copy
        FET_TEMP.AVG_TEMP_BUF = 0;                          // reset
        FET_TEMP.REAL_TEMP_VALUE = __calculate(avgFetTemp);
    }
#if 1
    BD_TEMP.AVG_TEMP_BUF += EXT_TEMP_ADC_CH11;
    BD_TEMP.AVG_CHK_CNT++;
    if (TEMP_AVG_CNT == BD_TEMP.AVG_CHK_CNT)
    {
        float avgBdTemp;
        BD_TEMP.AVG_CHK_CNT = 0;
        BD_TEMP.AVG_TEMP_BUF = (BD_TEMP.AVG_TEMP_BUF / TEMP_AVG_CNT);

        // To need change real current..
        avgBdTemp = 3.3 * BD_TEMP.AVG_TEMP_BUF / 4096;      // copy
        BD_TEMP.AVG_TEMP_BUF = 0;                           // reset
        BD_TEMP.REAL_TEMP_VALUE = __calculate(avgBdTemp);
    }
#else
#endif

}



